## sw/yocto-layers/meta-vssr-trd/conf/layer.conf
```bitbake
# meta-vssr-trd layer configuration file.
# Add recipes and classes to BBPATH
#
BBPATH .= ":${LAYERDIR}"

# We have recipes-* directories, add to BBFILES
BBFILES += "${LAYERDIR}/recipes-*/*/*.bb \
	${LAYERDIR}/recipes-*/*/*.bbappend"

BBFILE_COLLECTIONS += "meta-vssr-trd"
BBFILE_PATTERN_meta-vssr-trd = "^${LAYERDIR}/"
BBFILE_PRIORITY_meta-vssr-trd = "6"

LAYERDEPENDS_meta-vssr-trd = "jupyter-layer"

LAYERSERIES_COMPAT_meta-vssr-trd = "honister"
```
