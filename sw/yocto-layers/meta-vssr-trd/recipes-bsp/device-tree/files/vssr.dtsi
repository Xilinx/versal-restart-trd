/******************************************************************************
*
* Copyright (C) 2019 - 2021 Xilinx, Inc.  All rights reserved.
*
******************************************************************************/

/include/ "reserved-mem.dtsi"
/include/ "libmetal-shm.dtsi"

&serial1 {
	status = "disabled";
};

&watchdog {
	/* disable the pretimeout for the watchdog driver */
	pretimeout-sec = <0>;
};
