/******************************************************************************
*
* Copyright (C) 2019 - 2021 Xilinx, Inc.  All rights reserved.
*
******************************************************************************/

/{
	amba {
		compatible = "simple-bus";
		u-boot,dm-pre-reloc;
		#address-cells = <0x2>;
		#size-cells = <0x2>;
		ranges;
		/* Shared memory */
		shm0: shm@0 {
			compatible = "shm_uio";
			reg = <0x0 0x3e400000 0x0 0x00100000>;
		};
		/* IPI device */
		ipi_amp: ipi@ff340000 {
			compatible = "ipi_uio";
			reg = <0x0 0xff340000 0x0 0x1000>;
			interrupt-parent = <&gic>;
			interrupts = <0 29 4>;
		};
	};
};
